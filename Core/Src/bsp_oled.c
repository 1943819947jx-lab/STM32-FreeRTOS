#include "main.h"
#include "bsp_oled.h"

extern I2C_HandleTypeDef hi2c1;

#define OLED_ADDR (0x3C << 1)

static const uint8_t font6x8[96][6] = {
  {0x00,0x00,0x00,0x00,0x00,0x00}, {0x00,0x00,0x00,0x2F,0x00,0x00},
  {0x00,0x00,0x07,0x00,0x07,0x00}, {0x00,0x14,0x7F,0x14,0x7F,0x14},
  {0x00,0x24,0x2A,0x7F,0x2A,0x12}, {0x00,0x23,0x13,0x08,0x64,0x62},
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  {0x00,0x08,0x08,0x2A,0x1C,0x08}, {0x00,0x08,0x1C,0x2A,0x08,0x08}
};

static void oled_write_cmd(uint8_t cmd) {
  uint8_t d[2] = {0x00, cmd};
  HAL_I2C_Master_Transmit(&hi2c1, OLED_ADDR, d, 2, 100);
}
static void oled_write_data(uint8_t dt) {
  uint8_t d[2] = {0x40, dt};
  HAL_I2C_Master_Transmit(&hi2c1, OLED_ADDR, d, 2, 100);
}

void oled_init(void) {
  uint8_t init[] = {0xAE,0x20,0x00,0xB0,0xC8,0x00,0x10,0x40,0x81,0xFF,0xA1,0xA6,
                    0xA8,0x3F,0xA4,0xD3,0x00,0xD5,0x80,0xD9,0xF1,0xDA,0x12,0xDB,0x40,0x8D,0x14,0xAF};
  for (unsigned i = 0; i < sizeof(init); i++) oled_write_cmd(init[i]);
}

void oled_clear(void) {
  for (uint8_t page = 0; page < 8; page++) {
    oled_write_cmd(0xB0 + page); oled_write_cmd(0x00); oled_write_cmd(0x10);
    for (uint16_t i = 0; i < 128; i++) oled_write_data(0x00);
  }
}

void oled_string(uint8_t row, char *str) {
  oled_write_cmd(0xB0 + row); oled_write_cmd(0x00); oled_write_cmd(0x10);
  while (*str) {
    const uint8_t *p = font6x8[*str - 0x20];
    for (int i = 0; i < 6; i++) oled_write_data(p[i]);
    oled_write_data(0x00);
    str++;
  }
}
